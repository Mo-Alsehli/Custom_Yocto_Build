## meta-mmagdi-distro/conf/distro/mmagdi.conf
```bitbake
DISTRO = "mmagdi"
DISTRO_NAME = "mmagdi (A custom distro for me)"
DISTRO_VERSION = "1.0.0"
DISTRO_CODENAME = "kirkstone"

MAINTAINER = "Mohamed Magdi <github: https://github.com/Mo-Alsehli>"

#TARGET_VENDOR = "-raspberry-pi-3b"
TARGET_VENDOR = "-rpi3b"

########################### POKY DEFAULTS ################################################
##########################################################################################
DISTRO_CODENAME = "kirkstone"
SDK_VENDOR = "-pokysdk"
SDK_VERSION = "${@d.getVar('DISTRO_VERSION').replace('snapshot-${METADATA_REVISION}', 'snapshot')}"
SDK_VERSION[vardepvalue] = "${SDK_VERSION}"


LOCALCONF_VERSION = "2"

# Override these in poky based distros
POKY_DEFAULT_DISTRO_FEATURES = "largefile opengl ptest multiarch wayland vulkan"
POKY_DEFAULT_EXTRA_RDEPENDS = "packagegroup-core-boot"
POKY_DEFAULT_EXTRA_RRECOMMENDS = "kernel-module-af-packet"

DISTRO_FEATURES ?= "${DISTRO_FEATURES_DEFAULT} ${POKY_DEFAULT_DISTRO_FEATURES}"

PREFERRED_VERSION_linux-yocto ?= "5.15%"
PREFERRED_VERSION_linux-yocto-rt ?= "5.15%"

SDK_NAME = "${DISTRO}-${TCLIBC}-${SDKMACHINE}-${IMAGE_BASENAME}-${TUNE_PKGARCH}-${MACHINE}"
SDKPATHINSTALL = "/opt/${DISTRO}/${SDK_VERSION}"

DISTRO_EXTRA_RDEPENDS += "${POKY_DEFAULT_EXTRA_RDEPENDS}"
DISTRO_EXTRA_RRECOMMENDS += "${POKY_DEFAULT_EXTRA_RRECOMMENDS}"

TCLIBCAPPEND = ""

SANITY_TESTED_DISTROS ?= " \
            poky-3.3 \n \
            poky-3.4 \n \
            ubuntu-18.04 \n \
            ubuntu-20.04 \n \
            ubuntu-22.04 \n \
            ubuntu-24.04 \n \
            fedora-37 \n \
            fedora-39 \n \
            fedora-40 \n \
            debian-11 \n \
            opensuseleap-15.3 \n \
            almalinux-8.8 \n \
            almalinux-8.9 \n \
            almalinux-8.10 \n \
            almalinux-9.4 \n \
            "
# add poky sanity bbclass
INHERIT += "poky-sanity"

# QA check settings - a little stricter than the OE-Core defaults
# (none currently necessary as we now match OE-Core)
#WARN_TO_ERROR_QA = "X"
#WARN_QA_remove = "${WARN_TO_ERROR_QA}"
#ERROR_QA_append = " ${WARN_TO_ERROR_QA}"

require conf/distro/include/poky-world-exclude.inc
require conf/distro/include/no-static-libs.inc
require conf/distro/include/yocto-uninative.inc
require conf/distro/include/security_flags.inc
INHERIT += "uninative"

BB_SIGNATURE_HANDLER ?= "OEEquivHash"
BB_HASHSERVE ??= "auto"

######################################################################################
# tell it to give the .wic directly
#IMAGE_FSTYPES = "wic wic.bmap"


# Init Manager and backfill compatibilty.
VIRTUAL-RUNTIME_init_manager = "systemd"
DISTRO_FEATURES_BACKFILL_CONSIDERED:append = " sysvinit"
VIRTUAL-RUNTIME_initscripts = "systemd-compat-units"

# Distro Features.
DISTRO_FEATURES:append = " pam systemd wifi wayland"

# Image Features
IMAGE_FEATURES:append = " splash"


# Remove uneeded 
IMAGE_FEATURES:remove = "ssh-server-dropbear"
# Image Install apps
IMAGE_INSTALL:append = " python3 \
                         bash \
                         openssh \
                         wifi-config \
                         rdp-certs \
                         static-ip \
                         vsomeip \
                         client-example \
                         commonapi-core-runtime \
                         commonapi-someip-runtime \
                         commonapihw-client \
                         commonapi-filetf-client \
                         bootfiles-rpi \
                         update-screen-ui \
                         rpi-ota-update \
                        "
#IMAGE_INSTALL:remove = " weston-xwayland"

EXTRA_IMAGE_FEATURES ?= "debug-tweaks ssh-server-openssh"
# Change root password
INHERIT += "extrausers"
ROOT_PASSWD = "\$6\$Mh5L7et1F/EUZZNZ\$AJLz0I1Wht2dWngljgwPliiH2.gK4jDnIPxT68W4.AY5Gf1/vVkILDTKpukXzN/1oYVNMy2dXLYsqrt2/ut.o/"
EXTRA_USERS_PARAMS = "usermod -p '${ROOT_PASSWD}' root;"

# force using u-boot as bootloader (ONLY for Raspberry Pi)
#RPI_USE_U_BOOT:raspberrypi4 = "1"
PREFERRED_PROVIDER_virtual/bootloader:raspberrypi4 = "u-boot"
UBOOT_EXTLINUX:raspberrypi4 = "1" 
UBOOT_EXTLINUX_ROOT:raspberrypi4 = "root=LABEL=rootfsA"

# This is the alternative for setting UBOOT_EXTLINUX to 1
IMAGE_BOOT_FILES:append:raspberrypi4 = " extlinux/extlinux.conf"

# Custom wic partition layout file (located in meta-ota/wic)
IMAGE_FSTYPES:append = " wic wic.bmap"
WKS_FILE:raspberrypi4 = "rpi-ab.wks"
WKS_FILE:pn-image-name:raspberrypi4 = "rpi-ab.wks"

IMAGE_FSTYPES:append = " ext4"




# Enable UART for tty
# ENABLE_UART = "1"
# SERIAL_CONSOLES = "115200;ttyS0"

# Configure gpio17 as pull-up
#RPI_EXTRA_CONFIG:append = " gpio=17=ip,pu"
```

## meta-ota/conf/layer.conf
```bitbake
# We have a conf and classes directory, add to BBPATH
BBPATH .= ":${LAYERDIR}"

# We have recipes-* directories, add to BBFILES
BBFILES += "${LAYERDIR}/recipes-*/*/*.bb \
            ${LAYERDIR}/recipes-*/*/*.bbappend"

BBFILE_COLLECTIONS += "meta-ota"
BBFILE_PATTERN_meta-ota = "^${LAYERDIR}/"
BBFILE_PRIORITY_meta-ota = "6"

LAYERDEPENDS_meta-ota = "core"
LAYERSERIES_COMPAT_meta-ota = "kirkstone"
```

## meta-ota/wic/qemu-ab.wks
```
# Boot partition - U-Boot, kernel, extlinux
part /boot --source bootimg-partition --fstype=vfat --label boot --active --align 4 --size 512

# rootfsA - primary rootfs
part / --source rootfs --fstype=ext4 --label rootfsA --align 4 --size 4096

# rootfsB - OTA target
part --fstype=ext4 --label rootfsB --align 4 --size 4096

# Data partition
part --fstype=ext4 --label data --align 4 --size 1024
```

## meta-ota/wic/rpi-ab.wks
```
# boot (FAT32) - contains U-Boot artifacts, kernel, dtb, extlinux.conf
part /boot --source bootimg-partition --ondisk mmcblk0 --fstype=vfat --label boot --active --align 4 --size 256

# rootfsA - filled from Yocto rootfs
part / --source rootfs --ondisk mmcblk0 --fstype=ext4 --label rootfsA --align 4 --size 4096

# rootfsB - empty ext4 partition (will be written by OTA later)
part / --ondisk mmcblk0 --fstype=ext4 --label rootfsB --align 4 --size 6144

# optional persistent data partition
part /data --ondisk mmcblk0 --fstype=ext4 --label data --align 4 --size 512
```
